/dts-v1/;
/plugin/;

/ {
	fragment@0 {
		target-path = "/soc@0/soundwire@3210000";

		__overlay__ {
			#address-cells = <2>;
			#size-cells = <0>;

			haptics@0,0 {
				compatible = "sdw20217f00100";
				reg = <0 0>;

				mipi-sdw-simplified-clockstopprepare-sm-supported;
			};
		};
	};

	fragment@1 {
		target-path = "/sound";

		__overlay__ {
			audio-routing = "IN1_HPHL", "HPHL_OUT",
					"IN2_HPHR", "HPHR_OUT",
					"AMIC1", "MIC BIAS1",
					"AMIC2", "MIC BIAS2",
					"AMIC3", "MIC BIAS1",
					"AMIC4", "MIC BIAS3",
					"AMIC5", "MIC BIAS4",
					"TX SWR_INPUT0", "ADC1_OUTPUT",
					"TX SWR_INPUT1", "ADC2_OUTPUT",
					"TX SWR_INPUT4", "ADC3_OUTPUT",
					"TX SWR_INPUT5", "ADC4_OUTPUT",
					"TX SWR_INPUT8", "DMIC5_OUTPUT",
					"TX SWR_INPUT10", "DMIC7_OUTPUT",
					"TX SWR_INPUT11", "DMIC8_OUTPUT";
		};
	};
};
